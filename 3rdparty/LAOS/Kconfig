## 3rdparty/LAOS/Kconfig
```kconfig
#
# Copyright (c) 2012 DesingTure. All rights reserved.
# 
# This file contains the original code and/or modify of original code as
# defined in.
# All code in this file is property of DesignTure project, this code should
# not be distributed or commercialized.
# Only those involved in this project will have access to the code and no one
# else can see.
#

mainmenu "LAOS Configuration"

####################
menu "Build options"
####################

config TOOLCHAIN_DIR
        string "Toolchain directory"
        default "/please/change/me"
        help
            Path to directory to store toolchain downloads and build in.

config TOOLCHAIN_MAKE_JOBS
        int "Toolchain parallel build jobs"
        default 1
        help
            Argument to pass to -j for make when building the toolchain.

config EXTRA_CCFLAGS
        string "Extra CCFLAGS"
        default "-O2"
        help
            Extra compiler options for both C and C++ code.

config EXTRA_CFLAGS
        string "Extra CFLAGS"
        default ""
        help
            Extra compiler options for C code.

config EXTRA_CXXFLAGS
        string "Extra CXXFLAGS"
        default ""
        help
            Extra compiler options for C++ code.

config QEMU_BINARY
	string "QEMU binary"
	default "qemu-system-x86_64"
	help
	  Path to the QEMU binary to use for the qtest build target.

config QEMU_OPTS
	string "Extra QEMU options"
	default "-serial stdio -vga std -s -localtime -m 512"
	help
	  Extra options to pass to QEMU.

#######
endmenu
#######

comment "Target system "

source "config/Kconfig.arch"
source "config/Kconfig.platform"

comment "System configuration"

config DEBUG
	bool "Debug build"
	default y
	help
	  Enable various sections of debugging code and extra checks. For the
	  kernel, this enables assertions and messages with the LOG_DEBUG log
	  level. It also disables the boot splash screen by default. The built
	  system will generally be slower, so don't enable it unless you are
	  doing kernel development or have another reason to.

menu "LAOS configuration"
source "source/loader/Kconfig"
endmenu
```

## 3rdparty/LAOS/source/Kconfig
```kconfig
#
# Copyright (C) 2012-2013 Gil Mendes
#
# Permission is hereby granted, free of charge, to any person obtaining a copy of
# this software and associated documentation files (the "Software"), to deal in
# the Software without restriction, including without limitation the rights to
# use, copy, modify, merge, publish, distribute, sublicense, and/or sell copies of
# the Software, and to permit persons to whom the Software is furnished to do so,
# subject to the following conditions:
#
# The above copyright notice and this permission notice shall be included in all
# copies or substantial portions of the Software.
#
# THE SOFTWARE IS PROVIDED "AS IS", WITHOUT WARRANTY OF ANY KIND, EXPRESS OR
# IMPLIED, INCLUDING BUT NOT LIMITED TO THE WARRANTIES OF MERCHANTABILITY, FITNESS
# FOR A PARTICULAR PURPOSE AND NONINFRINGEMENT. IN NO EVENT SHALL THE AUTHORS OR
# COPYRIGHT HOLDERS BE LIABLE FOR ANY CLAIM, DAMAGES OR OTHER LIABILITY, WHETHER
# IN AN ACTION OF CONTRACT, TORT OR OTHERWISE, ARISING FROM, OUT OF OR IN
# CONNECTION WITH THE SOFTWARE OR THE USE OR OTHER DEALINGS IN THE SOFTWARE.
#

config LAOS_UI
	bool "Menu/configuration interface"
	default y
	depends on LAOS_HAVE_UI
	help
	  Enable the user interface. If disabled, the menu interface is disabled
	  so configuration files will not support multiple entries. The system
	  must be loaded at the top level of the config file.

#########################
menu "Filesystem support"
	depends on LAOS_HAVE_DISK
#########################

config LAOS_FS_EXT2
	bool "Ext2/3/4 filesystem"
	default y
	help
	  Enable support for booting from Ext2/3/4 filesystems.

config LAOS_FS_ISO9660
	bool "ISO9660 CDROM filesystem"
	default y
	help
	  Enable support for booting from ISO9660-formatted CDs.

config LAOS_FS_ZLIB
	bool "File decompression support"
	default y
	help
	  Enable support for reading compressed files via zlib.

#######
endmenu
#######

############################
menu "Partition map support"
	depends on LAOS_HAVE_DISK
############################

config LAOS_PARTITION_MAP_MSDOS
	bool "MS-DOS (MBR) partition support"
	default y
	help
	  Enable support for MS-DOS/MBR partition tables. You probably want
	  this.

#######
endmenu
#######

###############################
menu "Operating system support"
###############################

config LAOS_LOADER_LAOS
	bool "LAOS kernel support"
	default y
	depends on LAOS_HAVE_LOADER_LAOS32 || LAOS_HAVE_LOADER_LAOS64
	help
	  Enable support for loading kernels using the LAOS boot format.

config LAOS_LOADER_LINUX
	bool "Linux kernel support"
	default y
	depends on LAOS_HAVE_LOADER_LINUX
	help
	  Enable support for loading Linux kernels.

#######
endmenu
#######

if ARCH_ARM
source "arch/arm/Kconfig"
endif
if ARCH_X86
source "arch/x86/Kconfig"
endif

if PLATFORM_OMAP3
source "platform/omap3/Kconfig"
endif
if PLATFORM_PC
source "platform/pc/Kconfig"
endif
```

## Kconfig
```kconfig
#
# Copyright (C) 2012-2013 Designture
#
# Permission is hereby granted, free of charge, to any person obtaining a copy of
# this software and associated documentation files (the "Software"), to deal in
# the Software without restriction, including without limitation the rights to
# use, copy, modify, merge, publish, distribute, sublicense, and/or sell copies of
# the Software, and to permit persons to whom the Software is furnished to do so,
# subject to the following conditions:
#
# The above copyright notice and this permission notice shall be included in all
# copies or substantial portions of the Software.
#
# THE SOFTWARE IS PROVIDED "AS IS", WITHOUT WARRANTY OF ANY KIND, EXPRESS OR
# IMPLIED, INCLUDING BUT NOT LIMITED TO THE WARRANTIES OF MERCHANTABILITY, FITNESS
# FOR A PARTICULAR PURPOSE AND NONINFRINGEMENT. IN NO EVENT SHALL THE AUTHORS OR
# COPYRIGHT HOLDERS BE LIABLE FOR ANY CLAIM, DAMAGES OR OTHER LIABILITY, WHETHER
# IN AN ACTION OF CONTRACT, TORT OR OTHERWISE, ARISING FROM, OUT OF OR IN
# CONNECTION WITH THE SOFTWARE OR THE USE OR OTHER DEALINGS IN THE SOFTWARE.
#

mainmenu "Infinity OS Configuration"

config KERNELVERSION
		string
	option env="KERNELVERSION"

####################
menu "Build options"
####################

config TOOLCHAIN_DIR
	string "Toolchain directory"
	default "/please/change/me"
	help
		Path to directory to store toolchain downloads and builds in.

config TOOLCHAIN_MAKE_JOBS
	int "Toolchain parallel build jobs"
	default 4
	help
	  Argument to pass to -j for make when building the toolchain.

config EXTRA_CCFLAGS
	string "Extra CCFLAGS"
	default "-O2"
	help
	  Extra compiler options for both C and C++ code.

config EXTRA_CFLAGS
	string "Extra CFLAGS"
	default ""
	help
	  Extra compiler options for C code.

config EXTRA_CXXFLAGS
	string "Extra CXXFLAGS"
	default ""
	help
	  Extra compiler options for C++ code.

config QEMU_BINARY
	string "QEMU binary"
	default "qemu-system-x86_64"
	help
	  Path to the QEMU binary to use for the qtest build target.

config QEMU_OPTS
	string "Extra QEMU options"
	default "-serial stdio -vga std -s -localtime -m 256"
	help
	  Extra options to pass to QEMU.

config EXTRA_FSIMAGE
	string "Extra filesystem image contents"
	default ""
	help
	  Path to a directory containing extra files to copy in to the generated
	  filesystem image.

config FORCE_VIDEO_MODE
	string "Force a video mode to be used"
	default ""
	help
	  If set, the bootloader configuration file will be generated with the
	  video_mode option set to this value.

#######
endmenu
#######

comment "Target system"

source "config/Kconfig.arch"
source "config/Kconfig.platform"

comment "System configuration"

config DEBUG
	bool "Debug build"
	default y
	help
		Enable various sections of debugging code and extra checks. For the
		kernel, this enables assertions and messages with the LOG_DEBUG log
		level. It also disable the boot splash screen by default. The build
		system will generally be slower, so don't enable it unless you are
		doing kernel development or have another reason to.

menu "LAOS configuration"
source "source/boot/Kconfig"
endmenu

menu "Pulsar Kernel configuration"
source "source/kernel/Kconfig"
endmenu

# EOF
```

## config/Kconfig.arch
```kconfig
#
# Copyright (C) 2012-2013 Designture
#
# Permission is hereby granted, free of charge, to any person obtaining a copy of
# this software and associated documentation files (the "Software"), to deal in
# the Software without restriction, including without limitation the rights to
# use, copy, modify, merge, publish, distribute, sublicense, and/or sell copies of
# the Software, and to permit persons to whom the Software is furnished to do so,
# subject to the following conditions:
#
# The above copyright notice and this permission notice shall be included in all
# copies or substantial portions of the Software.
#
# THE SOFTWARE IS PROVIDED "AS IS", WITHOUT WARRANTY OF ANY KIND, EXPRESS OR
# IMPLIED, INCLUDING BUT NOT LIMITED TO THE WARRANTIES OF MERCHANTABILITY, FITNESS
# FOR A PARTICULAR PURPOSE AND NONINFRINGEMENT. IN NO EVENT SHALL THE AUTHORS OR
# COPYRIGHT HOLDERS BE LIABLE FOR ANY CLAIM, DAMAGES OR OTHER LIABILITY, WHETHER
# IN AN ACTION OF CONTRACT, TORT OR OTHERWISE, ARISING FROM, OUT OF OR IN
# CONNECTION WITH THE SOFTWARE OR THE USE OR OTHER DEALINGS IN THE SOFTWARE.
#

config 32BIT
	bool

config 64BIT
	bool

config SYS_SUPPORTS_LITTLE_ENDIAN
	bool

config SYS_SUPPORTS_BIG_ENDIAN
	bool

config TOOLCHAIN_LLVM
	bool

config TOOLCHAIN_GCC
	bool

# For LAOS compatibility.
config ARCH_X86
	bool
	select SYS_SUPPORTS_LITTLE_ENDIAN
	select TOOLCHAIN_LLVM

choice
	prompt "Architecture"
	default ARCH_AMD64

config ARCH_AMD64
	bool "AMD64"
	select 64BIT
	select ARCH_X86
	help
	  Target the built system to 64-bit x86 processors.

endchoice

config ARCH
	string
	default "amd64" if ARCH_AMD64
	default "mips" if ARCH_MIPS

config BOOTARCH
	string
	default "x86" if ARCH_AMD64
	default ARCH

config TOOLCHAIN_TARGET
	string
	default "x86_64-pulsar" if ARCH_AMD64

config ARCH_ASFLAGS
    string
    default ""

config ARCH_CCFLAGS
	string
	default ""

choice
    prompt "Endianness"
    default LITTLE_ENDIAN

config BIG_ENDIAN
    bool "Big endian"
    depends on SYS_SUPPORTS_BIG_ENDIAN

config LITTLE_ENDIAN
    bool "Little endian"
    depends on SYS_SUPPORTS_LITTLE_ENDIAN

endchoice
```

## source/drivers/Kconfig
```kconfig
#
# Copyright (C) 2014 Gil Mendes
#
# Permission is hereby granted, free of charge, to any person obtaining a copy of
# this software and associated documentation files (the "Software"), to deal in
# the Software without restriction, including without limitation the rights to
# use, copy, modify, merge, publish, distribute, sublicense, and/or sell copies of
# the Software, and to permit persons to whom the Software is furnished to do so,
# subject to the following conditions:
#
# The above copyright notice and this permission notice shall be included in all
# copies or substantial portions of the Software.
#
# THE SOFTWARE IS PROVIDED "AS IS", WITHOUT WARRANTY OF ANY KIND, EXPRESS OR
# IMPLIED, INCLUDING BUT NOT LIMITED TO THE WARRANTIES OF MERCHANTABILITY, FITNESS
# FOR A PARTICULAR PURPOSE AND NONINFRINGEMENT. IN NO EVENT SHALL THE AUTHORS OR
# COPYRIGHT HOLDERS BE LIABLE FOR ANY CLAIM, DAMAGES OR OTHER LIABILITY, WHETHER
# IN AN ACTION OF CONTRACT, TORT OR OTHERWISE, ARISING FROM, OUT OF OR IN
# CONNECTION WITH THE SOFTWARE OR THE USE OR OTHER DEALINGS IN THE SOFTWARE.
#

comment "Bus managers"

config DRIVER_BUS_PCI
	bool "PCI bus manager"
	default y
	help
	  Enable the PCI bus manager driver.

comment "Display devices"

config DRIVER_DISPLAY_VBE
	bool "VBE display device driver"
	default y
	depends on MODULE_PLATFORM_BIOS
	help
	  Enable the VBE display device driver.

comment "Input devices"

config DRIVER_INPUT_I8042
	bool "i8042 keyboard/mouse port driver"
	default y
	depends on PLATFORM_PC
 	help
	  Enable the i8042 (PS/2) keyboard/mouse port driver.
```
